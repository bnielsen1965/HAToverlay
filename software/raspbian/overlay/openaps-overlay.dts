/dts-v1/;
/plugin/;

/ {
    compatible = "brcm,bcm2835", "brcm,bcm2708", "brcm,bcm2709";

    fragment@0 {
        target = <&gpio>;
        __overlay__ {
            pinctrl-names = "default";
            pinctrl-0 = <&openaps_pins>;

            openaps_pins: openaps_pins {
                brcm,pins = <4 17 27>;     /* gpio no. */
                brcm,function = <0 0 0>; /* 0:in, 1:out */
                brcm,pull = <2 2 2>;     /* 2:up 1:down 0:none */
            };
        };
    };
};
